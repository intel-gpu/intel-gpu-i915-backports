## Kconfig
```kconfig
mainmenu "Backports from $BASE_KERNEL_NAME $DII_KERNEL_HEAD (backports $BACKPORTS_RELEASE_TAG)"

config BACKPORT_DIR
	string
	option env="BACKPORT_DIR"
config BACKPORTS_RELEASE_TAG
	string
	option env="BACKPORTS_RELEASE_TAG"
config DII_KERNEL_HEAD
	string
	option env="DII_KERNEL_HEAD"
config BASE_KERNEL_NAME
	string
	option env="BASE_KERNEL_NAME"
config DII_KERNEL_TAG
	string
	option env="DII_KERNEL_TAG"
config INTEL_PMT_FORCED
        bool
        option env="INTEL_PMT_FORCED"

# Packaging hacks
source "$BACKPORT_DIR/Kconfig.package.hacks"

# Code we backport
source "$BACKPORT_DIR/Kconfig.sources"

# these will be generated
source "$BACKPORT_DIR/Kconfig.kernel"
source "$BACKPORT_DIR/Kconfig.versions"
```
