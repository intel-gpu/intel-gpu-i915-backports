## Kconfig.local
```kconfig
config BACKPORTED_BACKPORT_DIR
	tristate
	default BACKPORT_DIR
config BACKPORTED_BACKPORTS_RELEASE_TAG
	tristate
	default BACKPORTS_RELEASE_TAG
config BACKPORTED_DII_KERNEL_HEAD
	tristate
	default DII_KERNEL_HEAD
config BACKPORTED_BASE_KERNEL_NAME
	tristate
	default BASE_KERNEL_NAME
config BACKPORTED_DII_KERNEL_TAG
	tristate
	default DII_KERNEL_TAG
config BACKPORTED_EXPERT
	tristate
	default EXPERT
config BACKPORTED_BP_MODULES
	tristate
	default BP_MODULES
config BACKPORTED_DRM_I915
	tristate
	default DRM_I915
config BACKPORTED_DRM_I915_FORCE_PROBE
	tristate
	default DRM_I915_FORCE_PROBE
config BACKPORTED_DRM_I915_CAPTURE_ERROR
	tristate
	default DRM_I915_CAPTURE_ERROR
config BACKPORTED_DRM_I915_COMPRESS_ERROR
	tristate
	default DRM_I915_COMPRESS_ERROR
config BACKPORTED_DRM_I915_USERPTR
	tristate
	default DRM_I915_USERPTR
config BACKPORTED_DRM_I915_GVT
	tristate
	default DRM_I915_GVT
config BACKPORTED_DRM_I915_GVT_KVMGT
	tristate
	default DRM_I915_GVT_KVMGT
config BACKPORTED_DRM_I915_PXP
	tristate
	default DRM_I915_PXP
config BACKPORTED_DRM_I915_DEBUGGER
	tristate
	default DRM_I915_DEBUGGER
config BACKPORTED_DRM_I915_SVM
	tristate
	default DRM_I915_SVM
config BACKPORTED_DRM_I915_ATS
	tristate
	default DRM_I915_ATS
config BACKPORTED_DRM_I915_WERROR
	tristate
	default DRM_I915_WERROR
config BACKPORTED_DRM_I915_DEBUG
	tristate
	default DRM_I915_DEBUG
config BACKPORTED_DRM_I915_DEBUG_MMIO
	tristate
	default DRM_I915_DEBUG_MMIO
config BACKPORTED_DRM_I915_DEBUG_GEM
	tristate
	default DRM_I915_DEBUG_GEM
config BACKPORTED_DRM_I915_DEBUG_GEM_ONCE
	tristate
	default DRM_I915_DEBUG_GEM_ONCE
config BACKPORTED_DRM_I915_ERRLOG_GEM
	tristate
	default DRM_I915_ERRLOG_GEM
config BACKPORTED_DRM_I915_TRACE_GEM
	tristate
	default DRM_I915_TRACE_GEM
config BACKPORTED_DRM_I915_TRACE_GTT
	tristate
	default DRM_I915_TRACE_GTT
config BACKPORTED_DRM_I915_SW_FENCE_DEBUG_OBJECTS
	tristate
	default DRM_I915_SW_FENCE_DEBUG_OBJECTS
config BACKPORTED_DRM_I915_SW_FENCE_CHECK_DAG
	tristate
	default DRM_I915_SW_FENCE_CHECK_DAG
config BACKPORTED_DRM_I915_DEBUG_GUC
	tristate
	default DRM_I915_DEBUG_GUC
config BACKPORTED_DRM_I915_DEBUG_IOV
	tristate
	default DRM_I915_DEBUG_IOV
config BACKPORTED_DRM_I915_SELFTEST
	tristate
	default DRM_I915_SELFTEST
config BACKPORTED_DRM_I915_SELFTEST_BROKEN
	tristate
	default DRM_I915_SELFTEST_BROKEN
config BACKPORTED_DRM_I915_LOW_LEVEL_TRACEPOINTS
	tristate
	default DRM_I915_LOW_LEVEL_TRACEPOINTS
config BACKPORTED_DRM_I915_DEBUG_VBLANK_EVADE
	tristate
	default DRM_I915_DEBUG_VBLANK_EVADE
config BACKPORTED_DRM_I915_DEBUG_RUNTIME_PM
	tristate
	default DRM_I915_DEBUG_RUNTIME_PM
config BACKPORTED_DRM_I915_DEBUG_WAKEREF
	tristate
	default DRM_I915_DEBUG_WAKEREF
config BACKPORTED_DRM_I915_PCIE_STRICT_WRITE_ORDERING
	tristate
	default DRM_I915_PCIE_STRICT_WRITE_ORDERING
config BACKPORTED_DRM_I915_DEBUG_CONTIGUOUS
	tristate
	default DRM_I915_DEBUG_CONTIGUOUS
config BACKPORTED_DRM_I915_DUMP_PPGTT
	tristate
	default DRM_I915_DUMP_PPGTT
config BACKPORTED_DRM_I915_REQUEST_TIMEOUT
	tristate
	default DRM_I915_REQUEST_TIMEOUT
config BACKPORTED_DRM_I915_FENCE_TIMEOUT
	tristate
	default DRM_I915_FENCE_TIMEOUT
config BACKPORTED_DRM_I915_USERFAULT_AUTOSUSPEND
	tristate
	default DRM_I915_USERFAULT_AUTOSUSPEND
config BACKPORTED_DRM_I915_HEARTBEAT_INTERVAL
	tristate
	default DRM_I915_HEARTBEAT_INTERVAL
config BACKPORTED_DRM_I915_PREEMPT_TIMEOUT
	tristate
	default DRM_I915_PREEMPT_TIMEOUT
config BACKPORTED_DRM_I915_PREEMPT_TIMEOUT_COMPUTE
	tristate
	default DRM_I915_PREEMPT_TIMEOUT_COMPUTE
config BACKPORTED_DRM_I915_PREEMPT_TIMEOUT_COMPUTE_COPY
	tristate
	default DRM_I915_PREEMPT_TIMEOUT_COMPUTE_COPY
config BACKPORTED_DRM_I915_MAX_REQUEST_BUSYWAIT
	tristate
	default DRM_I915_MAX_REQUEST_BUSYWAIT
config BACKPORTED_DRM_I915_STOP_TIMEOUT
	tristate
	default DRM_I915_STOP_TIMEOUT
config BACKPORTED_DRM_I915_TIMESLICE_DURATION
	tristate
	default DRM_I915_TIMESLICE_DURATION
config BACKPORTED_DRM_I915_DEBUGGER_KFIFO
	tristate
	default DRM_I915_DEBUGGER_KFIFO
config BACKPORTED_DRM_I915_UNSTABLE
	tristate
	default DRM_I915_UNSTABLE
config BACKPORTED_DRM_I915_CHICKEN_ASYNC_GET_PAGES
	tristate
	default DRM_I915_CHICKEN_ASYNC_GET_PAGES
config BACKPORTED_DRM_I915_CHICKEN_PARALLEL_USERPTR
	tristate
	default DRM_I915_CHICKEN_PARALLEL_USERPTR
config BACKPORTED_DRM_I915_CHICKEN_CLEAR_ON_CREATE
	tristate
	default DRM_I915_CHICKEN_CLEAR_ON_CREATE
config BACKPORTED_DRM_I915_CHICKEN_CLEAR_ON_FREE
	tristate
	default DRM_I915_CHICKEN_CLEAR_ON_FREE
config BACKPORTED_DRM_I915_CHICKEN_CLEAR_ON_IDLE
	tristate
	default DRM_I915_CHICKEN_CLEAR_ON_IDLE
config BACKPORTED_DRM_I915_INTEL_FABRIC
	tristate
	default DRM_I915_INTEL_FABRIC
config BACKPORTED_IAF_DEBUG_ENABLE
	tristate
	default IAF_DEBUG_ENABLE
config BACKPORTED_IAF_DEBUG_ALTERNATE_FW_LOAD
	tristate
	default IAF_DEBUG_ALTERNATE_FW_LOAD
config BACKPORTED_IAF_DEBUG_SELFTESTS
	tristate
	default IAF_DEBUG_SELFTESTS
config BACKPORTED_IAF_DEBUG_MBOX_ACCESS
	tristate
	default IAF_DEBUG_MBOX_ACCESS
config BACKPORTED_IAF_DEBUG_STARTUP
	tristate
	default IAF_DEBUG_STARTUP
config BACKPORTED_INTEL_HID_EVENT
	tristate
	default INTEL_HID_EVENT
config BACKPORTED_INTEL_VBTN
	tristate
	default INTEL_VBTN
config BACKPORTED_INTEL_INT0002_VGPIO
	tristate
	default INTEL_INT0002_VGPIO
config BACKPORTED_INTEL_OAKTRAIL
	tristate
	default INTEL_OAKTRAIL
config BACKPORTED_INTEL_BXTWC_PMIC_TMU
	tristate
	default INTEL_BXTWC_PMIC_TMU
config BACKPORTED_INTEL_CHTDC_TI_PWRBTN
	tristate
	default INTEL_CHTDC_TI_PWRBTN
config BACKPORTED_INTEL_MRFLD_PWRBTN
	tristate
	default INTEL_MRFLD_PWRBTN
config BACKPORTED_INTEL_PUNIT_IPC
	tristate
	default INTEL_PUNIT_IPC
config BACKPORTED_INTEL_RST
	tristate
	default INTEL_RST
config BACKPORTED_INTEL_SMARTCONNECT
	tristate
	default INTEL_SMARTCONNECT
config BACKPORTED_INTEL_TURBO_MAX_3
	tristate
	default INTEL_TURBO_MAX_3
config BACKPORTED_INTEL_UNCORE_FREQ_CONTROL
	tristate
	default INTEL_UNCORE_FREQ_CONTROL
config BACKPORTED_INTEL_VSEC
	tristate
	default INTEL_VSEC
config BACKPORTED_INTEL_PMT_CLASS
	tristate
	default INTEL_PMT_CLASS
config BACKPORTED_INTEL_PMT_TELEMETRY
	tristate
	default INTEL_PMT_TELEMETRY
config BACKPORTED_INTEL_PMT_CRASHLOG
	tristate
	default INTEL_PMT_CRASHLOG
config BACKPORTED_INTEL_MEI
	tristate
	default INTEL_MEI
config BACKPORTED_INTEL_MEI_ME
	tristate
	default INTEL_MEI_ME
config BACKPORTED_INTEL_MEI_TXE
	tristate
	default INTEL_MEI_TXE
config BACKPORTED_INTEL_MEI_GSC
	tristate
	default INTEL_MEI_GSC
config BACKPORTED_INTEL_MEI_HDCP
	tristate
	default INTEL_MEI_HDCP
config BACKPORTED_INTEL_MEI_PXP
	tristate
	default INTEL_MEI_PXP
config BACKPORTED_INTEL_MEI_GSC_PROXY
	tristate
	default INTEL_MEI_GSC_PROXY
config BACKPORTED_INTEL_MEI_IAF
	tristate
	default INTEL_MEI_IAF
config BACKPORTED_WATCHDOG
	tristate
	default WATCHDOG
config BACKPORTED_WATCHDOG_CORE
	tristate
	default WATCHDOG_CORE
config BACKPORTED_WATCHDOG_NOWAYOUT
	tristate
	default WATCHDOG_NOWAYOUT
config BACKPORTED_WATCHDOG_HANDLE_BOOT_ENABLED
	tristate
	default WATCHDOG_HANDLE_BOOT_ENABLED
config BACKPORTED_WATCHDOG_OPEN_TIMEOUT
	tristate
	default WATCHDOG_OPEN_TIMEOUT
config BACKPORTED_WATCHDOG_SYSFS
	tristate
	default WATCHDOG_SYSFS
config BACKPORTED_WATCHDOG_HRTIMER_PRETIMEOUT
	tristate
	default WATCHDOG_HRTIMER_PRETIMEOUT
config BACKPORTED_WATCHDOG_PRETIMEOUT_GOV
	tristate
	default WATCHDOG_PRETIMEOUT_GOV
config BACKPORTED_WATCHDOG_PRETIMEOUT_GOV_SEL
	tristate
	default WATCHDOG_PRETIMEOUT_GOV_SEL
config BACKPORTED_WATCHDOG_PRETIMEOUT_GOV_NOOP
	tristate
	default WATCHDOG_PRETIMEOUT_GOV_NOOP
config BACKPORTED_WATCHDOG_PRETIMEOUT_GOV_PANIC
	tristate
	default WATCHDOG_PRETIMEOUT_GOV_PANIC
config BACKPORTED_WATCHDOG_PRETIMEOUT_DEFAULT_GOV_NOOP
	tristate
	default WATCHDOG_PRETIMEOUT_DEFAULT_GOV_NOOP
config BACKPORTED_WATCHDOG_PRETIMEOUT_DEFAULT_GOV_PANIC
	tristate
	default WATCHDOG_PRETIMEOUT_DEFAULT_GOV_PANIC
config BACKPORTED_SOFT_WATCHDOG
	tristate
	default SOFT_WATCHDOG
config BACKPORTED_SOFT_WATCHDOG_PRETIMEOUT
	tristate
	default SOFT_WATCHDOG_PRETIMEOUT
config BACKPORTED_BD957XMUF_WATCHDOG
	tristate
	default BD957XMUF_WATCHDOG
config BACKPORTED_DA9052_WATCHDOG
	tristate
	default DA9052_WATCHDOG
config BACKPORTED_DA9055_WATCHDOG
	tristate
	default DA9055_WATCHDOG
config BACKPORTED_DA9063_WATCHDOG
	tristate
	default DA9063_WATCHDOG
config BACKPORTED_DA9062_WATCHDOG
	tristate
	default DA9062_WATCHDOG
config BACKPORTED_GPIO_WATCHDOG
	tristate
	default GPIO_WATCHDOG
config BACKPORTED_GPIO_WATCHDOG_ARCH_INITCALL
	tristate
	default GPIO_WATCHDOG_ARCH_INITCALL
config BACKPORTED_MENF21BMC_WATCHDOG
	tristate
	default MENF21BMC_WATCHDOG
config BACKPORTED_MENZ069_WATCHDOG
	tristate
	default MENZ069_WATCHDOG
config BACKPORTED_WDAT_WDT
	tristate
	default WDAT_WDT
config BACKPORTED_WM831X_WATCHDOG
	tristate
	default WM831X_WATCHDOG
config BACKPORTED_WM8350_WATCHDOG
	tristate
	default WM8350_WATCHDOG
config BACKPORTED_XILINX_WATCHDOG
	tristate
	default XILINX_WATCHDOG
config BACKPORTED_ZIIRAVE_WATCHDOG
	tristate
	default ZIIRAVE_WATCHDOG
config BACKPORTED_RAVE_SP_WATCHDOG
	tristate
	default RAVE_SP_WATCHDOG
config BACKPORTED_MLX_WDT
	tristate
	default MLX_WDT
config BACKPORTED_SL28CPLD_WATCHDOG
	tristate
	default SL28CPLD_WATCHDOG
config BACKPORTED_ARM_SP805_WATCHDOG
	tristate
	default ARM_SP805_WATCHDOG
config BACKPORTED_ARM_SBSA_WATCHDOG
	tristate
	default ARM_SBSA_WATCHDOG
config BACKPORTED_ARMADA_37XX_WATCHDOG
	tristate
	default ARMADA_37XX_WATCHDOG
config BACKPORTED_ASM9260_WATCHDOG
	tristate
	default ASM9260_WATCHDOG
config BACKPORTED_AT91RM9200_WATCHDOG
	tristate
	default AT91RM9200_WATCHDOG
config BACKPORTED_AT91SAM9X_WATCHDOG
	tristate
	default AT91SAM9X_WATCHDOG
config BACKPORTED_SAMA5D4_WATCHDOG
	tristate
	default SAMA5D4_WATCHDOG
config BACKPORTED_CADENCE_WATCHDOG
	tristate
	default CADENCE_WATCHDOG
config BACKPORTED_21285_WATCHDOG
	tristate
	default 21285_WATCHDOG
config BACKPORTED_977_WATCHDOG
	tristate
	default 977_WATCHDOG
config BACKPORTED_FTWDT010_WATCHDOG
	tristate
	default FTWDT010_WATCHDOG
config BACKPORTED_IXP4XX_WATCHDOG
	tristate
	default IXP4XX_WATCHDOG
config BACKPORTED_S3C2410_WATCHDOG
	tristate
	default S3C2410_WATCHDOG
config BACKPORTED_SA1100_WATCHDOG
	tristate
	default SA1100_WATCHDOG
config BACKPORTED_DW_WATCHDOG
	tristate
	default DW_WATCHDOG
config BACKPORTED_EP93XX_WATCHDOG
	tristate
	default EP93XX_WATCHDOG
config BACKPORTED_OMAP_WATCHDOG
	tristate
	default OMAP_WATCHDOG
config BACKPORTED_PNX4008_WATCHDOG
	tristate
	default PNX4008_WATCHDOG
config BACKPORTED_IOP_WATCHDOG
	tristate
	default IOP_WATCHDOG
config BACKPORTED_DAVINCI_WATCHDOG
	tristate
	default DAVINCI_WATCHDOG
config BACKPORTED_K3_RTI_WATCHDOG
	tristate
	default K3_RTI_WATCHDOG
config BACKPORTED_ORION_WATCHDOG
	tristate
	default ORION_WATCHDOG
config BACKPORTED_RN5T618_WATCHDOG
	tristate
	default RN5T618_WATCHDOG
config BACKPORTED_SUNXI_WATCHDOG
	tristate
	default SUNXI_WATCHDOG
config BACKPORTED_NPCM7XX_WATCHDOG
	tristate
	default NPCM7XX_WATCHDOG
config BACKPORTED_TWL4030_WATCHDOG
	tristate
	default TWL4030_WATCHDOG
config BACKPORTED_STMP3XXX_RTC_WATCHDOG
	tristate
	default STMP3XXX_RTC_WATCHDOG
config BACKPORTED_TS4800_WATCHDOG
	tristate
	default TS4800_WATCHDOG
config BACKPORTED_TS72XX_WATCHDOG
	tristate
	default TS72XX_WATCHDOG
config BACKPORTED_MAX63XX_WATCHDOG
	tristate
	default MAX63XX_WATCHDOG
config BACKPORTED_MAX77620_WATCHDOG
	tristate
	default MAX77620_WATCHDOG
config BACKPORTED_IMX2_WDT
	tristate
	default IMX2_WDT
config BACKPORTED_IMX_SC_WDT
	tristate
	default IMX_SC_WDT
config BACKPORTED_IMX7ULP_WDT
	tristate
	default IMX7ULP_WDT
config BACKPORTED_UX500_WATCHDOG
	tristate
	default UX500_WATCHDOG
config BACKPORTED_RETU_WATCHDOG
	tristate
	default RETU_WATCHDOG
config BACKPORTED_MOXART_WDT
	tristate
	default MOXART_WDT
config BACKPORTED_ST_LPC_WATCHDOG
	tristate
	default ST_LPC_WATCHDOG
config BACKPORTED_TEGRA_WATCHDOG
	tristate
	default TEGRA_WATCHDOG
config BACKPORTED_QCOM_WDT
	tristate
	default QCOM_WDT
config BACKPORTED_MESON_GXBB_WATCHDOG
	tristate
	default MESON_GXBB_WATCHDOG
config BACKPORTED_MESON_WATCHDOG
	tristate
	default MESON_WATCHDOG
config BACKPORTED_MEDIATEK_WATCHDOG
	tristate
	default MEDIATEK_WATCHDOG
config BACKPORTED_DIGICOLOR_WATCHDOG
	tristate
	default DIGICOLOR_WATCHDOG
config BACKPORTED_ARM_SMC_WATCHDOG
	tristate
	default ARM_SMC_WATCHDOG
config BACKPORTED_LPC18XX_WATCHDOG
	tristate
	default LPC18XX_WATCHDOG
config BACKPORTED_RENESAS_WDT
	tristate
	default RENESAS_WDT
config BACKPORTED_RENESAS_RZAWDT
	tristate
	default RENESAS_RZAWDT
config BACKPORTED_ASPEED_WATCHDOG
	tristate
	default ASPEED_WATCHDOG
config BACKPORTED_STM32_WATCHDOG
	tristate
	default STM32_WATCHDOG
config BACKPORTED_STPMIC1_WATCHDOG
	tristate
	default STPMIC1_WATCHDOG
config BACKPORTED_UNIPHIER_WATCHDOG
	tristate
	default UNIPHIER_WATCHDOG
config BACKPORTED_RTD119X_WATCHDOG
	tristate
	default RTD119X_WATCHDOG
config BACKPORTED_SPRD_WATCHDOG
	tristate
	default SPRD_WATCHDOG
config BACKPORTED_PM8916_WATCHDOG
	tristate
	default PM8916_WATCHDOG
config BACKPORTED_VISCONTI_WATCHDOG
	tristate
	default VISCONTI_WATCHDOG
config BACKPORTED_MSC313E_WATCHDOG
	tristate
	default MSC313E_WATCHDOG
config BACKPORTED_ACQUIRE_WDT
	tristate
	default ACQUIRE_WDT
config BACKPORTED_ADVANTECH_WDT
	tristate
	default ADVANTECH_WDT
config BACKPORTED_ALIM1535_WDT
	tristate
	default ALIM1535_WDT
config BACKPORTED_ALIM7101_WDT
	tristate
	default ALIM7101_WDT
config BACKPORTED_EBC_C384_WDT
	tristate
	default EBC_C384_WDT
config BACKPORTED_F71808E_WDT
	tristate
	default F71808E_WDT
config BACKPORTED_SP5100_TCO
	tristate
	default SP5100_TCO
config BACKPORTED_GEODE_WDT
	tristate
	default GEODE_WDT
config BACKPORTED_SC520_WDT
	tristate
	default SC520_WDT
config BACKPORTED_SBC_FITPC2_WATCHDOG
	tristate
	default SBC_FITPC2_WATCHDOG
config BACKPORTED_EUROTECH_WDT
	tristate
	default EUROTECH_WDT
config BACKPORTED_IB700_WDT
	tristate
	default IB700_WDT
config BACKPORTED_IBMASR
	tristate
	default IBMASR
config BACKPORTED_WAFER_WDT
	tristate
	default WAFER_WDT
config BACKPORTED_I6300ESB_WDT
	tristate
	default I6300ESB_WDT
config BACKPORTED_IE6XX_WDT
	tristate
	default IE6XX_WDT
config BACKPORTED_INTEL_MID_WATCHDOG
	tristate
	default INTEL_MID_WATCHDOG
config BACKPORTED_ITCO_WDT
	tristate
	default ITCO_WDT
config BACKPORTED_ITCO_VENDOR_SUPPORT
	tristate
	default ITCO_VENDOR_SUPPORT
config BACKPORTED_IT8712F_WDT
	tristate
	default IT8712F_WDT
config BACKPORTED_IT87_WDT
	tristate
	default IT87_WDT
config BACKPORTED_HP_WATCHDOG
	tristate
	default HP_WATCHDOG
config BACKPORTED_HPWDT_NMI_DECODING
	tristate
	default HPWDT_NMI_DECODING
config BACKPORTED_KEMPLD_WDT
	tristate
	default KEMPLD_WDT
config BACKPORTED_SC1200_WDT
	tristate
	default SC1200_WDT
config BACKPORTED_SCx200_WDT
	tristate
	default SCx200_WDT
config BACKPORTED_PC87413_WDT
	tristate
	default PC87413_WDT
config BACKPORTED_NV_TCO
	tristate
	default NV_TCO
config BACKPORTED_RDC321X_WDT
	tristate
	default RDC321X_WDT
config BACKPORTED_60XX_WDT
	tristate
	default 60XX_WDT
config BACKPORTED_SBC8360_WDT
	tristate
	default SBC8360_WDT
config BACKPORTED_SBC7240_WDT
	tristate
	default SBC7240_WDT
config BACKPORTED_CPU5_WDT
	tristate
	default CPU5_WDT
config BACKPORTED_SMSC_SCH311X_WDT
	tristate
	default SMSC_SCH311X_WDT
config BACKPORTED_SMSC37B787_WDT
	tristate
	default SMSC37B787_WDT
config BACKPORTED_TQMX86_WDT
	tristate
	default TQMX86_WDT
config BACKPORTED_VIA_WDT
	tristate
	default VIA_WDT
config BACKPORTED_W83627HF_WDT
	tristate
	default W83627HF_WDT
config BACKPORTED_W83877F_WDT
	tristate
	default W83877F_WDT
config BACKPORTED_W83977F_WDT
	tristate
	default W83977F_WDT
config BACKPORTED_MACHZ_WDT
	tristate
	default MACHZ_WDT
config BACKPORTED_SBC_EPX_C3_WATCHDOG
	tristate
	default SBC_EPX_C3_WATCHDOG
config BACKPORTED_INTEL_MEI_WDT
	tristate
	default INTEL_MEI_WDT
config BACKPORTED_NI903X_WDT
	tristate
	default NI903X_WDT
config BACKPORTED_NIC7018_WDT
	tristate
	default NIC7018_WDT
config BACKPORTED_M54xx_WATCHDOG
	tristate
	default M54xx_WATCHDOG
config BACKPORTED_ATH79_WDT
	tristate
	default ATH79_WDT
config BACKPORTED_BCM47XX_WDT
	tristate
	default BCM47XX_WDT
config BACKPORTED_RC32434_WDT
	tristate
	default RC32434_WDT
config BACKPORTED_INDYDOG
	tristate
	default INDYDOG
config BACKPORTED_JZ4740_WDT
	tristate
	default JZ4740_WDT
config BACKPORTED_WDT_MTX1
	tristate
	default WDT_MTX1
config BACKPORTED_SIBYTE_WDOG
	tristate
	default SIBYTE_WDOG
config BACKPORTED_AR7_WDT
	tristate
	default AR7_WDT
config BACKPORTED_TXX9_WDT
	tristate
	default TXX9_WDT
config BACKPORTED_OCTEON_WDT
	tristate
	default OCTEON_WDT
config BACKPORTED_BCM63XX_WDT
	tristate
	default BCM63XX_WDT
config BACKPORTED_BCM2835_WDT
	tristate
	default BCM2835_WDT
config BACKPORTED_BCM_KONA_WDT
	tristate
	default BCM_KONA_WDT
config BACKPORTED_BCM_KONA_WDT_DEBUG
	tristate
	default BCM_KONA_WDT_DEBUG
config BACKPORTED_BCM7038_WDT
	tristate
	default BCM7038_WDT
config BACKPORTED_IMGPDC_WDT
	tristate
	default IMGPDC_WDT
config BACKPORTED_LANTIQ_WDT
	tristate
	default LANTIQ_WDT
config BACKPORTED_LOONGSON1_WDT
	tristate
	default LOONGSON1_WDT
config BACKPORTED_RALINK_WDT
	tristate
	default RALINK_WDT
config BACKPORTED_MT7621_WDT
	tristate
	default MT7621_WDT
config BACKPORTED_PIC32_WDT
	tristate
	default PIC32_WDT
config BACKPORTED_PIC32_DMT
	tristate
	default PIC32_DMT
config BACKPORTED_GEF_WDT
	tristate
	default GEF_WDT
config BACKPORTED_MPC5200_WDT
	tristate
	default MPC5200_WDT
config BACKPORTED_8xxx_WDT
	tristate
	default 8xxx_WDT
config BACKPORTED_PIKA_WDT
	tristate
	default PIKA_WDT
config BACKPORTED_BOOKE_WDT
	tristate
	default BOOKE_WDT
config BACKPORTED_BOOKE_WDT_DEFAULT_TIMEOUT
	tristate
	default BOOKE_WDT_DEFAULT_TIMEOUT
config BACKPORTED_MEN_A21_WDT
	tristate
	default MEN_A21_WDT
config BACKPORTED_WATCHDOG_RTAS
	tristate
	default WATCHDOG_RTAS
config BACKPORTED_DIAG288_WATCHDOG
	tristate
	default DIAG288_WATCHDOG
config BACKPORTED_SH_WDT
	tristate
	default SH_WDT
config BACKPORTED_WATCHDOG_CP1XXX
	tristate
	default WATCHDOG_CP1XXX
config BACKPORTED_WATCHDOG_RIO
	tristate
	default WATCHDOG_RIO
config BACKPORTED_WATCHDOG_SUN4V
	tristate
	default WATCHDOG_SUN4V
config BACKPORTED_XEN_WDT
	tristate
	default XEN_WDT
config BACKPORTED_UML_WATCHDOG
	tristate
	default UML_WATCHDOG
config BACKPORTED_PCWATCHDOG
	tristate
	default PCWATCHDOG
config BACKPORTED_MIXCOMWD
	tristate
	default MIXCOMWD
config BACKPORTED_WDT
	tristate
	default WDT
config BACKPORTED_PCIPCWATCHDOG
	tristate
	default PCIPCWATCHDOG
config BACKPORTED_WDTPCI
	tristate
	default WDTPCI
config BACKPORTED_USBPCWATCHDOG
	tristate
	default USBPCWATCHDOG
config BACKPORTED_KEEMBAY_WATCHDOG
	tristate
	default KEEMBAY_WATCHDOG
```
