## drivers/gpu/drm/i915/Kconfig
```kconfig
# SPDX-License-Identifier: GPL-2.0-only
config DRM_I915
	tristate "Intel 8xx/9xx/G3x/G4x/HD Graphics"
	depends on m
	depends on m
	depends on DRM || BUILD_I915
	depends on X86 && PCI
	depends on INTERVAL_TREE
	# we need shmfs for the swappable backing store, and in particular
	# the shmem_readpage() which depends upon tmpfs
	depends on SHMEM
	depends on TMPFS
	select DRM_KMS_HELPER if DRM
	depends on DRM_PANEL
	select DRM_MIPI_DSI if DRM
	depends on RELAY
	depends on IRQ_WORK
	# i915 depends on ACPI_VIDEO when ACPI is enabled
	# but for select to work, need to select ACPI_VIDEO's dependencies, ick
	select BACKLIGHT_CLASS_DEVICE if ACPI
	select INPUT if ACPI
	select ACPI_VIDEO if ACPI
	select ACPI_BUTTON if ACPI
	select IOSF_MBI if X86
	depends on CRC32
	select SND_HDA_I915 if SND_HDA_CORE
	select CEC_CORE if CEC_NOTIFIER
	select VMAP_PFN if (BACKPORT_RHEL_KERNEL_8_5 || BACKPORT_RHEL_KERNEL_8_6)
	depends on AUXILIARY_BUS || MFD_CORE
	depends on MTD
	help
	  Choose this option if you have a system that has "Intel Graphics
	  Media Accelerator" or "HD Graphics" integrated graphics,
	  including 830M, 845G, 852GM, 855GM, 865G, 915G, 945G, 965G,
	  G35, G41, G43, G45 chipsets and Celeron, Pentium, Core i3,
	  Core i5, Core i7 as well as Atom CPUs with integrated graphics.

	  This driver is used by the Intel driver in X.org 6.8 and
	  XFree86 4.4 and above. It replaces the older i830 module that
	  supported a subset of the hardware in older X.org releases.

	  Note that the older i810/i815 chipsets require the use of the
	  i810 driver instead, and the Atom z5xx series has an entirely
	  different implementation.

	  If "M" is selected, the module will be called i915.

config DRM_I915_CAPTURE_ERROR
	bool "Enable capturing GPU state following a hang"
	depends on DRM_I915
	default y
	help
	  This option enables capturing the GPU state when a hang is detected.
	  This information is vital for triaging hangs and assists in debugging.
	  Please report any hang to your Intel representative to help with triaging.

	  If in doubt, say "Y".

config DRM_I915_COMPRESS_ERROR
	bool "Compress GPU error state"
	depends on DRM_I915_CAPTURE_ERROR
	depends on ZLIB_DEFLATE
	default y
	help
	  This option selects ZLIB_DEFLATE if it isn't already
	  selected and causes any error state captured upon a GPU hang
	  to be compressed using zlib.

	  If in doubt, say "Y".

config DRM_I915_DISPLAY
	bool "Enable display support"
	depends on DRM_I915
	default y
	help
	   Disable this option only if you want to compile out display support.

config DRM_I915_PXP
	bool "Enable Intel PXP support for Intel Gen12 and newer platform"
	depends on DRM_I915
	depends on INTEL_MEI && INTEL_MEI_PXP
	default n
	help
	  PXP (Protected Xe Path) is an i915 component, available on GEN12 and
	  newer GPUs, that helps to establish the hardware protected session and
	  manage the status of the alive software session, as well as its life
	  cycle.

config DRM_I915_DEBUGGER
       bool "Enable Debugger support in i915"
       depends on DRM_I915
       default y if DRM_I915_DEBUG
       select DRM_I915_CAPTURE_ERROR
       help
	 Choose this option if you want to add support for debugger (gdb) to
	 attach into processes using i915 and debug the gpu/gpgpu programs.
	 With debugger support, i915 will provide interface for a debugger
	 process to track, inspect and modify resources.

menu "drm/i915 Debugging"
depends on DRM_I915
depends on EXPERT
source "drivers/gpu/drm/i915/Kconfig.debug"
endmenu

menu "drm/i915 Profile Guided Optimisation"
	visible if EXPERT
	depends on DRM_I915
	source "drivers/gpu/drm/i915/Kconfig.profile"
endmenu

menu "drm/i915 Unstable Evolution"
	visible if EXPERT && STAGING && BROKEN
	depends on DRM_I915
	source "drivers/gpu/drm/i915/Kconfig.unstable"
endmenu

menu "drm/i915 Chickens"
	visible if EXPERT && STAGING
	depends on DRM_I915
	source "drivers/gpu/drm/i915/Kconfig.chicken"
endmenu

menu "drm/i915/fabric Intel Fabric Connectivity driver support"
	depends on DRM_I915
	source "drivers/gpu/drm/i915/fabric/Kconfig"
endmenu
```

## drivers/gpu/drm/i915/Kconfig.chicken
```kconfig
config DRM_I915_CHICKEN_ASYNC_GET_PAGES
	bool "Asynchronous backing store fetch (get_pages)"
	default y
	help
	  Acquire and clear the backing store (chunks of local memory or pages
	  of system memory) in a background thread, returning to userspace
	  without blocking. Access or execution of the object is deferred
	  instead.

config DRM_I915_CHICKEN_PARALLEL_USERPTR
       bool "Parallelised backing store fetch of get_user_pages"
       default y
       help
         Allow the userptr backing store acquire to parallelise its work over
	 multiple threads.

config DRM_I915_CHICKEN_CLEAR_ON_CREATE
	bool "Clear backing store immediately upon create"
	default n
	help
	  Queue the clear of all objects at the point of creation (GEM_CREATE
	  ioctl), ahead of first use.

config DRM_I915_CHICKEN_CLEAR_ON_FREE
	bool "Clear backing store on release"
	default y
	help
	  Clear pages on release, ahead of reuse. Only applies to local memory.

config DRM_I915_CHICKEN_CLEAR_ON_IDLE
	bool "Clear backing store on idle (boot)"
	default y
	help
	  Clear local memory on idling, and upon boot.

config DRM_I915_CHICKEN_ULL_DMA_BOOST
	bool "Disable processor C-states to minimise DMA latency"
	default y
	help
	  Set the CPU-DMA latency requirement to 0 to disable processor C-states
	  as we wait for an interrupt on user-fences for ULL compute contexts.

config DRM_I915_CHICKEN_SOFT_PG
	bool "Manually disable/enable powergating around execution"
	default y
	help
	  Powergating is used to put the GT completely asleep by turning the
	  clocks off when idle. This is normally driven by a HW hysteresis
	  monitoring when all engines are idle. However, this can incur a large
	  exit latency delaying the start of subsequeny execution, and in any
	  sitations the client will remain active for the entire duration that
	  the GT is awake, and so we can effectively disable powergating upon
	  wakeup, restoring the power saving when we know all clients are idle.
```

## drivers/mfd/Kconfig
```kconfig
# SPDX-License-Identifier: GPL-2.0-only
#
# Multifunction miscellaneous devices
#

if HAS_IOMEM
menu "Multifunction device drivers"

config MFD_CORE
	tristate
	depends on m
	depends on IRQ_DOMAIN
	default n

config MFD_INTEL_PMT
	tristate "Intel Platform Monitoring Technology (PMT) support"
	depends on m
	depends on PCI
	depends on (AUXILIARY_BUS != y) || INTEL_PMT_FORCED
	select MFD_CORE
	help
	  The Intel Platform Monitoring Technology (PMT) is an interface that
	  provides access to hardware monitor registers. This driver supports
	  Telemetry, Watcher, and Crashlog PMT capabilities/devices for
	  platforms starting from Tiger Lake.

endmenu
endif
```
